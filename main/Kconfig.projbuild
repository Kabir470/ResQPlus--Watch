## main/Kconfig.projbuild
```kconfig
menu "Main"

    menu "WiFi"

        config MAIN_WIFI_SSID
            string "WiFi SSID"
            default ""
            help
                SSID for the WiFi network to connect to when pressing the WiFi button.

        config MAIN_WIFI_PASSWORD
            string "WiFi Password"
            default ""
            help
                Password for the WiFi network.

    endmenu

endmenu
```
